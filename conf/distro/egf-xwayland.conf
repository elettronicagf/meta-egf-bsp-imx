## conf/machine/imx93-egf-3sm1010.conf
```bitbake
#@TYPE: Machine
#@NAME: EGF SOM 3SM1010
#@SOC: i.MX93
#@DESCRIPTION: Machine configuration for EGF SOM 3SM1010
#@MAINTAINER: Andrea Collamati <andrea.collamati@elettronicagf.it>

MACHINEOVERRIDES =. "mx93:"

require conf/machine/include/imx-base.inc
require conf/machine/include/arm/armv8-2a/tune-cortexa55.inc

# NXP BSP can consume proprietary jailhouse and Marvell drivers
# OP-TEE is also applicable to NXP BSP, mainline BSP seems not to have
# a full support for it yet.
MACHINE_FEATURES:append:use-nxp-bsp = " optee jailhouse mrvl8997"
MACHINE_FEATURES:append = " wifi bluetooth nxpwifi-all-sdio"

SERIAL_CONSOLES = "115200;ttyLP2"

PREFERRED_PROVIDER_virtual/kernel:imx93-egf-3sm1010 ?= "linux-imx-egf"
KERNEL_DEVICETREE = " \
    freescale/imx93-egf-3pb1001.dtb \
    freescale/imx93-egf-3hi5005.dtb \   
    freescale/imx93-egf-3hi5011.dtb \   
"

PREFERRED_PROVIDER_u-boot:imx93-egf-3sm1010 ?= "u-boot-imx-egf"
PREFERRED_PROVIDER_virtual/bootloader:imx93-egf-3sm1010 ?= "u-boot-imx-egf"


UBOOT_DTB_NAME = "${MACHINE}.dtb"
IMX_DEFAULT_BOOTLOADER:use-nxp-bsp = "u-boot-imx"
UBOOT_SUFFIX = "bin"
UBOOT_CONFIG_BASENAME = "egf_3sm1010"
UBOOT_CONFIG ??= "emmc"
UBOOT_CONFIG[emmc] = "${UBOOT_CONFIG_BASENAME}_defconfig"

SPL_BINARY = "spl/u-boot-spl.bin"
ATF_PLATFORM = "imx93"

IMXBOOT_TARGETS = "flash_singleboot"

IMX_BOOT_SOC_TARGET = "iMX9"
IMX_BOOT_SEEK = "32"


DDR_FIRMWARE_NAME = " \
    lpddr4_dmem_1d_v202201.bin \
    lpddr4_dmem_2d_v202201.bin \
    lpddr4_imem_1d_v202201.bin \
    lpddr4_imem_2d_v202201.bin \
"

IMX_DEFAULT_BSP = "nxp"
```
